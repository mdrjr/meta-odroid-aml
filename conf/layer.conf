## conf/layer.conf
```bitbake
# We have a conf and classes directory, add to BBPATH
BBPATH .= ":${LAYERDIR}"

# We have recipes-* directories, add to BBFILES
BBFILES += "${LAYERDIR}/recipes-*/*/*.bb \
            ${LAYERDIR}/recipes-*/*/*.bbappend"

BBFILE_COLLECTIONS += "odroid-aml"
BBFILE_PATTERN_odroid-aml = "^${LAYERDIR}/"
BBFILE_PRIORITY_odroid-aml = "10"
LAYERVERSION_odroid-aml = "4"
LAYERSERIES_COMPAT_odroid-aml = "styhead"
LAYERDEPENDS_odroid-aml = "core openembedded-layer"
```

## conf/machine/mali-c5.inc
```bitbake
PREFERRED_PROVIDER_virtual/libgl ?= "mesa-gl"
PREFERRED_PROVIDER_virtual/mesa ?= "mesa-gl"

PREFERRED_PROVIDER_virtual/egl ?= "libmali-odroid-c5"
PREFERRED_PROVIDER_virtual/libgles1 ?= "libmali-odroid-c5"
PREFERRED_PROVIDER_virtual/libgles2 ?= "libmali-odroid-c5"
PREFERRED_PROVIDER_virtual/libgles3 ?= "libmali-odroid-c5"
PREFERRED_PROVIDER_virtual/libopencl ?= "libmali-odroid-c5"
PREFERRED_PROVIDER_virtual/libgbm ?= "libmali-odroid-c5"

DEPENDS:append:pn-mesa-gl = " libmali-odroid-c5"
```

## wic/odroid-c5.wks
```
bootloader --ptable msdos

part --source rawcopy --sourceparams="file=u-boot.bin.signed" --offset 1S

# fat partition, with 100Mb
part /boot --source bootimg-partition --ondisk mmcblk --fstype=vfat --label boot --active --align 1024 --fixed-size 100 --use-uuid

# Rootfs partition
part / --source rootfs --ondisk mmcblk --fstype ext4 --label rootfs --align 4096 --use-uuid --fixed-size=1024
```
