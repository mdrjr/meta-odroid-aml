## conf/machine/odroid-c5.conf
```bitbake
# Copyright (c) 2025, Hardkernel Co., Ltd
# Released under the MIT license (see COPYING.MIT for the terms)

#@TYPE: Machine
#@NAME: ODROID-C5

require conf/machine/include/arm/armv8-2a/tune-cortexa55.inc
require conf/machine/odroid.inc
require conf/machine/mali-c5.inc

PREFERRED_VERSION_linux-odroid-aml := "6.12%"
PREFERRED_PROVIDER_virtual/bootloader ?= "u-boot-odroid-c5"
PREFERRED_PROVIDER_virtual/kernel ?= "linux-odroid-aml"

KERNEL_DEVICETREE = "s7d_s905x5m_odroidc5.dtb"
IMAGE_BOOT_FILES += "Image s7d_s905x5m_odroidc5.dtb"

do_image_wic[depends] += "odroid-c5-initramfs:do_image_complete"
IMAGE_BOOT_FILES += "odroid-c5-initramfs-${MACHINE}.cpio.gz;initrd.img"

PACKAGECONFIG:remove:pn-perf = "scripting"

RDEPENDS:${KERNEL_PACKAGE_NAME}-base = ""

WKS_FILE ?= "odroid-c5.wks"
```

## files/wic/odroid-c4.wks
```
bootloader --ptable msdos

part --source rawcopy --sourceparams="file=u-boot.bin" --offset 1S --no-table

part /boot --source bootimg-partition --ondisk mmcblk --fstype=vfat --label boot --active --align 1024 --fixed-size 100 --use-uuid

part --source empty --ondisk mmcblk --fstype=ext4 --label reserved --align 1024 --fixed-size 8 --use-uuid

part / --source rootfs --ondisk mmcblk --fstype ext4 --label rootfs --align 4096 --use-uuid --fixed-size=1536
```
